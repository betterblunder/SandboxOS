## buildroot-external/overlay_defconfig
```kconfig
BR2_CCACHE=y

# BR2_PACKAGE_SHAIRPORT_SYNC=y

BR2_PACKAGE_MOTIONEYE=y
BR2_PACKAGE_MOTION=y
BR2_PACKAGE_LIBV4L=y # required to build motion with local camera
BR2_PACKAGE_LIBV4L_UTILS=y
```
